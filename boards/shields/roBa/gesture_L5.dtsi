/{
        gesture_window: gesture_window {
                compatible = "zmk,input-processor-mouse-gesture";
                #input-processor-cells = <0>;
        
                enable-eager-mode;
                movement-threshold = <6>;
                idle-timeout-ms = <120>;
                gesture-cooldown-ms = <150>;
        
bindings = <
                &mouse_gesture // Activates mouse gesture while it is pressed
                &mouse_gesture_on // Activates mouse gesture on each press
                &mouse_gesture_off // Deactivates mouse gesture on each press
                &mouse_gesture_toggle // Toggle mouse gesture on/off on each press
                &mouse_gesture_kp 0 A // Activates mouse gesture while held, and triggers &kp A on tap
                &mouse_gesture_mkp 0 RCLK // Activates mouse gesture while held, and triggers right click on tap
>;

        };
};
